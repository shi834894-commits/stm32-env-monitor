#include "bsp_oled.h"
#include "bsp_i2c.h"
#include "log.h"
#include <string.h>

static uint8_t OLED_Buffer[OLED_PAGES][OLED_WIDTH];
static uint8_t OLED_InitRefreshProgress;
static uint8_t OLED_Address = OLED_I2C_ADDR;

static const uint8_t OLED_InitCmd[] = {
    0xAE,
    0xD5, 0x80,
    0xA8, 0x3F,
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    0xA6,
    0xAF
};

static const uint8_t Font6x8[][6] = {
    {0x00,0x00,0x00,0x00,0x00,0x00}, // ' '
    {0x00,0x00,0x5F,0x00,0x00,0x00}, // '!'
    {0x00,0x07,0x00,0x07,0x00,0x00}, // '"'
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    {0x08,0x08,0x2A,0x1C,0x08,0x00}, // '~'
};

static uint8_t OLED_WriteCmd(uint8_t cmd)
{
    I2C_Start();
    I2C_SendByte((OLED_Address << 1) | 0x00);
    if (I2C_WaitAck() != GPIO_PIN_RESET)
    {
        I2C_Stop();
        return 0;
    }
    I2C_SendByte(0x00);
    if (I2C_WaitAck() != GPIO_PIN_RESET)
    {
        I2C_Stop();
        return 0;
    }
    I2C_SendByte(cmd);
    if (I2C_WaitAck() != GPIO_PIN_RESET)
    {
        I2C_Stop();
        return 0;
    }
    I2C_Stop();
    return 1;
}

static uint8_t OLED_WriteData(uint8_t data)
{
    I2C_Start();
    I2C_SendByte((OLED_Address << 1) | 0x00);
    if (I2C_WaitAck() != GPIO_PIN_RESET)
    {
        I2C_Stop();
        return 0;
    }
    I2C_SendByte(0x40);
    if (I2C_WaitAck() != GPIO_PIN_RESET)
    {
        I2C_Stop();
        return 0;
    }
    I2C_SendByte(data);
    if (I2C_WaitAck() != GPIO_PIN_RESET)
    {
        I2C_Stop();
        return 0;
    }
    I2C_Stop();
    return 1;
}

static uint8_t OLED_ProbeAddress(uint8_t address)
{
    uint8_t ack;

    I2C_Start();
    I2C_SendByte((address << 1) | 0x00U);
    ack = I2C_WaitAck();
    I2C_Stop();
    return ack == GPIO_PIN_RESET;
}

uint8_t OLED_Init(void)
{
    if (LOG("[OLED] startup delay\r\n") != HAL_OK)
    {
        Error_Handler();
    }
    HAL_Delay(100);
    if (OLED_ProbeAddress(OLED_I2C_ADDR))
    {
        OLED_Address = OLED_I2C_ADDR;
    }
    else if (OLED_ProbeAddress(0x3DU))
    {
        OLED_Address = 0x3DU;
    }
    else
    {
        if (LOG("[OLED] no device ACK at 0x3C or 0x3D\r\n") != HAL_OK)
        {
            Error_Handler();
        }
        return 0;
    }
    if (LOG("[OLED] device address 0x%02X\r\n", (unsigned int)OLED_Address) != HAL_OK)
    {
        Error_Handler();
    }
    if (LOG("[OLED] sending initialization commands\r\n") != HAL_OK)
    {
        Error_Handler();
    }
    for (uint16_t i = 0; i < sizeof(OLED_InitCmd); i++)
    {
        if (!OLED_WriteCmd(OLED_InitCmd[i]))
        {
            if (LOG("[OLED] initialization command failed at index %u\r\n",
                    (unsigned int)i) != HAL_OK)
            {
                Error_Handler();
            }
            return 0;
        }
    }
    if (LOG("[OLED] initialization commands complete\r\n") != HAL_OK)
    {
        Error_Handler();
    }
    OLED_Clear();
    OLED_InitRefreshProgress = 1;
    if (LOG("[OLED] initial refresh started\r\n") != HAL_OK)
    {
        Error_Handler();
    }
    uint8_t refreshOk = OLED_Refresh();
    OLED_InitRefreshProgress = 0;
    if (refreshOk && LOG("[OLED] initial refresh complete\r\n") != HAL_OK)
    {
        Error_Handler();
    }
    return refreshOk;
}

void OLED_Clear(void)
{
    memset(OLED_Buffer, 0, sizeof(OLED_Buffer));
}

uint8_t OLED_Refresh(void)
{
    for (uint8_t page = 0; page < OLED_PAGES; page++)
    {
        if (OLED_InitRefreshProgress &&
            LOG("[OLED] initial refresh page %u\r\n", (unsigned int)page) != HAL_OK)
        {
            Error_Handler();
        }
        if (!OLED_WriteCmd(0xB0 + page) ||
            !OLED_WriteCmd(0x00) ||
            !OLED_WriteCmd(0x10))
        {
            return 0;
        }
        for (uint8_t col = 0; col < OLED_WIDTH; col++)
        {
            if (!OLED_WriteData(OLED_Buffer[page][col]))
            {
                return 0;
            }
        }
    }
    return 1;
}

void OLED_SetPixel(uint8_t x, uint8_t y, uint8_t val)
{
    if (x >= OLED_WIDTH || y >= OLED_HEIGHT)
        return;
    uint8_t page = y / 8;
    uint8_t bit = y % 8;
    if (val)
        OLED_Buffer[page][x] |= (1 << bit);
    else
        OLED_Buffer[page][x] &= ~(1 << bit);
}

void OLED_DrawChar(uint8_t x, uint8_t y, char ch)
{
    if (ch < ' ' || ch > '~')
        ch = ' ';
    uint8_t idx = ch - ' ';
    for (uint8_t i = 0; i < 6; i++)
    {
        uint8_t col_data = Font6x8[idx][i];
        for (uint8_t bit = 0; bit < 8; bit++)
        {
            OLED_SetPixel(x + i, y + bit, (col_data >> bit) & 0x01);
        }
    }
}

void OLED_DrawString(uint8_t x, uint8_t y, const char *str)
{
    while (*str)
    {
        OLED_DrawChar(x, y, *str);
        x += 6;
        if (x + 6 > OLED_WIDTH)
        {
            x = 0;
            y += 8;
        }
        str++;
    }
}

void OLED_DrawNum(uint8_t x, uint8_t y, uint32_t num, uint8_t len)
{
    char buf[12];
    if (len == 0 || len >= sizeof(buf))
    {
        return;
    }

    for (int8_t i = len - 1; i >= 0; i--)
    {
        buf[i] = (num % 10) + '0';
        num /= 10;
    }
    buf[len] = '\0';
    OLED_DrawString(x, y, buf);
}

void OLED_DrawFloat(uint8_t x, uint8_t y, float num, uint8_t int_len, uint8_t fra_len)
{
    char buf[16];
    uint8_t idx = 0;

    if (int_len == 0 || int_len >= 10 || fra_len > sizeof(buf) - int_len - 2)
    {
        return;
    }

    if (num < 0)
    {
        if (fra_len > sizeof(buf) - int_len - 3)
        {
            return;
        }
        buf[idx++] = '-';
        num = -num;
    }

    uint32_t int_part = (uint32_t)num;
    float fra_part = num - (float)int_part;
    char int_buf[10];

    for (int8_t i = int_len - 1; i >= 0; i--)
    {
        int_buf[i] = (int_part % 10) + '0';
        int_part /= 10;
    }

    uint8_t first_digit = 0;
    while (first_digit + 1 < int_len && int_buf[first_digit] == '0')
        first_digit++;
    while (first_digit < int_len)
        buf[idx++] = int_buf[first_digit++];

    buf[idx++] = '.';

    for (uint8_t i = 0; i < fra_len; i++)
    {
        fra_part *= 10;
        buf[idx++] = ((uint32_t)fra_part % 10) + '0';
    }

    buf[idx] = '\0';
    OLED_DrawString(x, y, buf);
}

static const uint8_t Font16x16[][32] = {
    {0x00,0x00,0x23,0xF8,0x12,0x08,0x12,0x08,0x83,0xF8,0x42,0x08,0x42,0x08,0x13,0xF8,
     0x10,0x00,0x27,0xFC,0xE4,0xA4,0x24,0xA4,0x24,0xA4,0x44,0x94,0x0C,0x04,0x00,0x00},
    {0x00,0x00,0x01,0xF8,0x01,0x00,0x01,0x00,0xFF,0xFE,0x01,0x00,0x01,0x00,0x01,0x00,
     0x01,0x00,0x05,0x00,0x09,0x00,0x31,0x00,0xC1,0x00,0x01,0x00,0x01,0x00,0x01,0x00},
    {0x00,0x00,0x27,0xF8,0x14,0x08,0x14,0x08,0x87,0xF8,0x44,0x08,0x44,0x08,0x17,0xF8,
     0x11,0x20,0x21,0x20,0xE9,0x24,0x25,0x28,0x23,0x30,0x21,0x20,0x29,0x24,0x31,0x22},
};

void OLED_DrawChinese(uint8_t x, uint8_t y, uint8_t no)
{
    if (no >= sizeof(Font16x16) / sizeof(Font16x16[0]))
        return;

    for (uint8_t row = 0; row < 16; row++)
    {
        uint16_t row_data = ((uint16_t)Font16x16[no][row * 2] << 8)
                          | Font16x16[no][row * 2 + 1];
        for (uint8_t col = 0; col < 16; col++)
        {
            OLED_SetPixel(x + col, y + row,
                          (row_data & (0x8000u >> col)) != 0);
        }
    }
}
